## CMakeLists.txt
```
cmake_minimum_required(VERSION 3.20.0)
find_package(Zephyr REQUIRED HINTS $ENV{ZEPHYR_BASE})
project(thernet)
target_sources(app PRIVATE src/main.c)
```

## prj.conf
```kconfig
CONFIG_NETWORKING=y
CONFIG_POSIX_API=y
# CONFIG_NET_TEST=y
CONFIG_NET_IPV4=y

CONFIG_NET_CONFIG_SETTINGS=y
CONFIG_NET_CONFIG_NEED_IPV4=y
CONFIG_NET_L2_ETHERNET=y
CONFIG_ETH_INIT_PRIORITY=90
CONFIG_NET_CONFIG_AUTO_INIT=y
CONFIG_NET_CONFIG_MY_IPV4_ADDR="192.0.2.2"
CONFIG_NET_CONFIG_MY_IPV4_NETMASK="255.255.255.0"
CONFIG_NET_CONFIG_MY_IPV4_GW="192.0.2.1"

# RAND
CONFIG_ENTROPY_GENERATOR=y
CONFIG_TEST_RANDOM_GENERATOR=y

# LOGGING
CONFIG_LOG=y
CONFIG_LOG_MODE_DEFERRED=n
CONFIG_LOG_DEFAULT_LEVEL=3

# CONFIG_ZTEST=y
CONFIG_ETH_DRIVER=y
CONFIG_NET_BUF=y
CONFIG_NET_LOG=y
CONFIG_NETWORKING=y
CONFIG_NET_IPV4=y
CONFIG_NET_DHCPV4=n
CONFIG_ETH_INIT_PRIORITY=80

# Driver Ethernet STM32
CONFIG_ETH_STM32_HAL=y
CONFIG_NET_CONFIG_SETTINGS=y
CONFIG_NET_CONFIG_AUTO_INIT=y
CONFIG_NET_CONFIG_NEED_IPV4=y

# Stack e buffer
CONFIG_NET_PKT_RX_COUNT=16
CONFIG_NET_PKT_TX_COUNT=16
CONFIG_NET_BUF_RX_COUNT=32
CONFIG_NET_BUF_TX_COUNT=32
CONFIG_MAIN_STACK_SIZE=2048
```

## src/main.c
```c
#include <zephyr/net/net_if.h>
#include <zephyr/net/net_config.h>
#include <zephyr/net/net_ip.h>
#include <zephyr/net/net_event.h>
#include <zephyr/logging/log.h>
#include <zephyr/kernel.h>

LOG_MODULE_REGISTER(main, LOG_LEVEL_INF);

int main(void)
{
    // 1. Récupération de l'interface par défaut
    struct net_if *iface = net_if_get_default();
    
    if (!iface) {
        LOG_ERR("Aucune interface réseau détectée.");
        return -ENODEV;
    }
    
    struct net_if_config *cfg = net_if_get_config(iface);
    
    // CORRECTION : Accès à .ipv4.is_used
    if (!cfg || !cfg->ip.ipv4 || !cfg->ip.ipv4->unicast[0].ipv4.is_used) {
        LOG_ERR("Pas de configuration IPv4 ou d'adresse IP attribuée.");
        return -ENOENT;
    }
    
    char addr_str[NET_IPV4_ADDR_LEN];
    
    // CORRECTION : Accès à .ipv4.address.in_addr
    net_addr_ntop(
        AF_INET,
        &cfg->ip.ipv4->unicast[0].ipv4.address.in_addr,
        addr_str,
        sizeof(addr_str)
    );

    LOG_INF("Adresse IP: %s", addr_str);

    return 0;
}
```
