## CMakeLists.txt
```
cmake_minimum_required(VERSION 3.20.0)
find_package(Zephyr REQUIRED HINTS $ENV{ZEPHYR_BASE})
project(icmp_server_simple)
target_sources(app PRIVATE src/main.c)
```

## prj.conf
```kconfig
CONFIG_NETWORKING=y
CONFIG_NET_IPV4=y
CONFIG_LOG=y
CONFIG_PRINTK=y
CONFIG_NET_LOG=y
```

## src/main.c
```c
#include <zephyr/net/net_core.h>
#include <zephyr/net/net_if.h>
#include <zephyr/net/net_pkt.h>
#include <zephyr/net/net_ip.h>
#include <zephyr/kernel.h>

int main(void)
{
    printk("Serveur ICMP actif. Testez avec: ping 192.0.2.4\n");
    return 0;
}
```
